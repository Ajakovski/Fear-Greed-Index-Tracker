## Firmware/main/Kconfig.projbuild
```kconfig
menu "Fear and Greed Configuration"
    config WIFI_SSID
        string "a"
        default "myssid"
    config WIFI_PASSWORD 
        string "a"
        default "mypassword"
endmenu        
```

## desk_tracker/Kconfig.projbuild
```kconfig
menu "Desk Tracker Configuration"
    config WIFI_SSID
        string "a"
        default "myssid"
    config WIFI_PASSWORD 
        string "a"
        default "mypassword"
endmenu        
```
